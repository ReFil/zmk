## app/boards/arm/crbn60/Kconfig.board
```kconfig
# CRBN60 board configuration

# Copyright (c) 2021 Polarity Works
# SPDX-License-Identifier: MIT

config BOARD_CRBN60
	bool "crbn60"
	depends on SOC_NRF52840_QIAA
```

## app/boards/arm/rotr/Kconfig.board
```kconfig
# ROTR board configuration

# Copyright (c) 2021 Polarity Works
# SPDX-License-Identifier: MIT

config BOARD_ROTR
	bool "ROTR"
	depends on SOC_NRF52840_QIAA
```

## app/boards/arm/rotr/Kconfig.defconfig
```kconfig
# ROTR board configuration

# Copyright (c) 2021 Polarity Works
# SPDX-License-Identifier: MIT

if BOARD_ROTR

config BOARD
	default "rotr"

if USB

config USB_NRFX
	default y

config USB_DEVICE_STACK
	default y

endif # USB

config BT_CTLR
	default BT

config ZMK_BLE
	default y

config ZMK_USB
	default y

config ZMK_BATTERY_VOLTAGE_DIVIDER
	default y

config ZMK_KEYBOARD_NAME
	default "ROTR"

endif # BOARD_ROTR
```

## app/boards/arm/stp/Kconfig.board
```kconfig
# STP board configuration

# Copyright (c) 2023 Polarity Works
# SPDX-License-Identifier: MIT

config BOARD_STP
    bool "stp"
    depends on SOC_NRF52840_QIAA
```

## app/boards/arm/stp/Kconfig.defconfig
```kconfig
# Copyright (c) 2021 Polarity Works
# SPDX-License-Identifier: MIT

if BOARD_STP

config BOARD
    default "stp"

if USB

config USB_NRFX
    default y

config USB_DEVICE_STACK
    default y

endif # USB

config BT_CTLR
    default BT

config ZMK_BLE
    default y

config ZMK_USB
    default y

config ZMK_BATTERY_VOLTAGE_DIVIDER
    default y

config ZMK_KEYBOARD_NAME
    default "Form"

if ZMK_STUDIO
config ZMK_STUDIO_RPC_RX_BUF_SIZE
    default 128

config ZMK_STUDIO_RPC_TX_BUF_SIZE
    default 256

endif

endif # BOARD_STP
```

## app/boards/arm/stp/stp_defconfig
```kconfig
#
# Copyright (c) 2024 The ZMK Contributors
# SPDX-License-Identifier: MIT
#

CONFIG_SOC_SERIES_NRF52X=y
CONFIG_SOC_NRF52840_QIAA=y
CONFIG_BOARD_STP=y

# Enable MPU
CONFIG_ARM_MPU=y

# Enable GPIO and pinctrl
CONFIG_GPIO=y
CONFIG_PINCTRL=y

# Enable SPI for LEDS
CONFIG_SPI=y
CONFIG_SPI_NRFX=y

# Trackpad configuration
CONFIG_I2C=y
CONFIG_ZMK_MOUSE=y
CONFIG_ZMK_TRACKPAD=y
CONFIG_ZMK_TRACKPAD_PHYSICAL_X=650
CONFIG_ZMK_TRACKPAD_PHYSICAL_Y=1065
CONFIG_ZMK_TRACKPAD_LOGICAL_X=650
CONFIG_ZMK_TRACKPAD_LOGICAL_Y=1065
CONFIG_ZMK_TRACKPAD_REVERSE_SCROLL=y
CONFIG_ZMK_TRACKPAD_FINGERS=4
CONFIG_ZMK_BLE_MOUSE_REPORT_QUEUE_SIZE=30
CONFIG_GEN4=y
CONFIG_GEN4_TRIGGER_GLOBAL_THREAD=y

# Enable writing to flash
CONFIG_USE_DT_CODE_PARTITION=y
CONFIG_MPU_ALLOW_FLASH_WRITE=y
CONFIG_NVS=y
CONFIG_SETTINGS_NVS=y
CONFIG_FLASH=y
CONFIG_FLASH_PAGE_LAYOUT=y
CONFIG_FLASH_MAP=y

# Enable 32kHz crystal
CONFIG_CLOCK_CONTROL_NRF_K32SRC_XTAL=y
CONFIG_CLOCK_CONTROL_NRF_K32SRC_150PPM=y

# RGB leds config
CONFIG_ZMK_STP_INDICATORS=y
CONFIG_ZMK_STP_INDICATORS_BRT_MAX=10
CONFIG_WS2812_STRIP=y

# Backlighting configuration
CONFIG_PWM=y
CONFIG_LED_PWM=y
CONFIG_ZMK_BACKLIGHT=y
CONFIG_ZMK_BACKLIGHT_BRT_START=25
CONFIG_ZMK_BACKLIGHT_BRT_STEP=25
CONFIG_ZMK_BACKLIGHT_AUTO_OFF_IDLE=y

# BT configuration
CONFIG_ZMK_BLE=y
CONFIG_ZMK_BLE_EXPERIMENTAL_CONN=y
CONFIG_BT_CTLR_TX_PWR_PLUS_8=y
CONFIG_BT_DIS_MANUF="Kinesis Corporation"
CONFIG_BT_DIS_PNP_VID=0x29EA
CONFIG_BT_DIS_PNP_PID=0x1000
CONFIG_BT_MAX_CONN=2
CONFIG_BT_MAX_PAIRED=2

# USB configuration
CONFIG_ZMK_USB=y
CONFIG_USB_DEVICE_VID=0x29EA
CONFIG_USB_DEVICE_PID=0x1000
CONFIG_USB_DEVICE_MANUFACTURER="Kinesis Corporation"

# Misc configuration
CONFIG_ZMK_PROFILESWITCH=y
CONFIG_ZMK_HID_REPORT_TYPE_NKRO=n
CONFIG_ZMK_HID_CONSUMER_REPORT_USAGES_FULL=y
CONFIG_BUILD_OUTPUT_UF2=y
```

## app/module/drivers/sensor/Kconfig
```kconfig
# Copyright (c) 2020 The ZMK Contributors
# SPDX-License-Identifier: MIT

if SENSOR

rsource "battery/Kconfig"
rsource "ec11/Kconfig"
rsource "max17048/Kconfig"
rsource "gen4/Kconfig"

endif # SENSOR
```

## app/module/drivers/sensor/gen4/Kconfig
```kconfig
# Copyright (c) 2023 The ZMK Contributors
# SPDX-License-Identifier: MIT

menuconfig GEN4
    bool "Cirque Gen4 trackpads"
    depends on GPIO
    depends on I2C
    help
      Enable driver for Cirque Gen4 trackpads

if GEN4

choice
    prompt "Trigger mode"
    default GEN4_TRIGGER_NONE
    help
      Specify the type of triggering to be used by the driver.

config GEN4_TRIGGER_NONE
    bool "No trigger"

config GEN4_TRIGGER_GLOBAL_THREAD
    bool "Use global thread"
    depends on GPIO
    select GEN4_TRIGGER

config GEN4_TRIGGER_OWN_THREAD
    bool "Use own thread"
    depends on GPIO
    select GEN4_TRIGGER

endchoice

config GEN4_TRIGGER
    bool

config GEN4_THREAD_PRIORITY
    int "Thread priority"
    depends on GEN4_TRIGGER_OWN_THREAD
    default 10
    help
      Priority of thread used by the driver to handle interrupts.

config GEN4_THREAD_STACK_SIZE
    int "Thread stack size"
    depends on GEN4_TRIGGER_OWN_THREAD
    default 1024
    help
      Stack size of thread used by the driver to handle interrupts.

endif # GEN4
```

## app/module/dts/bindings/sensor/cirque,gen4.yaml
```yaml
description: |
  Sensor driver for the Cirque Gen4 trackpad ASICs
compatible: "cirque,gen4"
include: ["i2c-device.yaml"]

properties:
  dr-gpios:
    type: phandle-array
    description: Data ready pin for the trackpad
```
